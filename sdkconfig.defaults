## sdkconfig.defaults
```kconfig
CONFIG_EXAMPLE_RECONFIGURE_BUTTON=0
CONFIG_STATUS_LED_GPIO=15
CONFIG_ESPTOOLPY_FLASHSIZE_4MB=y
CONFIG_ESPTOOLPY_FLASHSIZE="4MB"
CONFIG_PARTITION_TABLE_CUSTOM=y
CONFIG_PARTITION_TABLE_CUSTOM_FILENAME="partitions.csv"
CONFIG_PARTITION_TABLE_FILENAME="partitions.csv"
CONFIG_TINYUSB_NET_MODE_NCM=y
CONFIG_ESP_CONSOLE_UART_CUSTOM=y
CONFIG_ESP_CONSOLE_UART_CUSTOM_NUM_1=y
CONFIG_ESP_CONSOLE_UART_NUM=1
CONFIG_ESP_CONSOLE_ROM_SERIAL_PORT_NUM=1
CONFIG_ESP_CONSOLE_UART_TX_GPIO=37
CONFIG_ESP_CONSOLE_UART_RX_GPIO=39
CONFIG_ESP_CONSOLE_UART_BAUDRATE=115200
CONFIG_SPIRAM=y
CONFIG_SPIRAM_MODE_QUAD=y
CONFIG_SPIRAM_TYPE_AUTO=y
CONFIG_SPIRAM_SPEED_40M=y
CONFIG_SPIRAM_SPEED=40
CONFIG_SPIRAM_BOOT_HW_INIT=y
CONFIG_SPIRAM_BOOT_INIT=y
CONFIG_SPIRAM_PRE_CONFIGURE_MEMORY_PROTECTION=y
CONFIG_SPIRAM_USE_MALLOC=y
CONFIG_SPIRAM_MEMTEST=y
CONFIG_SPIRAM_MALLOC_ALWAYSINTERNAL=4096
CONFIG_SPIRAM_TRY_ALLOCATE_WIFI_LWIP=y
CONFIG_SPIRAM_MALLOC_RESERVE_INTERNAL=32768
CONFIG_SPIRAM_ALLOW_BSS_SEG_EXTERNAL_MEMORY=y
CONFIG_ESP_WIFI_STATIC_RX_BUFFER_NUM=10
CONFIG_ESP_WIFI_RX_BA_WIN=6
CONFIG_LWIP_TCP_OOSEQ_MAX_PBUFS=4
# Let firmware decide whether config-mode DHCP advertises DNS.
# Local-only mode must not force macOS to use the ESP as DNS.
CONFIG_LWIP_DHCPS_ADD_DNS=n
CONFIG_ESP_COREDUMP_ENABLE_TO_FLASH=y
CONFIG_ESP_COREDUMP_DATA_FORMAT_ELF=y
CONFIG_ESP_COREDUMP_CHECKSUM_CRC32=y
CONFIG_ESP_COREDUMP_CAPTURE_DRAM=y
CONFIG_ESP_COREDUMP_CHECK_BOOT=y
CONFIG_ESP_COREDUMP_LOGS=y
CONFIG_ESP_COREDUMP_MAX_TASKS_NUM=32
CONFIG_ESP_COREDUMP_FLASH_NO_OVERWRITE=y
CONFIG_ESP_COREDUMP_STACK_SIZE=2048
CONFIG_MDNS_MAX_INTERFACES=4
CONFIG_MDNS_MEMORY_ALLOC_SPIRAM=y
# CONFIG_MDNS_MEMORY_ALLOC_INTERNAL is not set
CONFIG_ESP_TASK_WDT_PANIC=y
CONFIG_ESP_SYSTEM_PANIC_PRINT_REBOOT=y
CONFIG_ESP_SYSTEM_PANIC_REBOOT_DELAY_SECONDS=5
CONFIG_COMPILER_STACK_CHECK_MODE_ALL=y
CONFIG_FREERTOS_CHECK_STACKOVERFLOW_CANARY=y
CONFIG_FREERTOS_WATCHPOINT_END_OF_STACK=y
CONFIG_HEAP_POISONING_LIGHT=y
CONFIG_HEAP_ABORT_WHEN_ALLOCATION_FAILS=y
# CONFIG_LOG_DEFAULT_LEVEL_DEBUG is not set
CONFIG_LOG_DEFAULT_LEVEL_INFO=y
CONFIG_LOG_DEFAULT_LEVEL=3
CONFIG_LOG_MAXIMUM_LEVEL_DEBUG=y
CONFIG_LOG_MAXIMUM_LEVEL=4
```

## src/Kconfig.projbuild
```kconfig
menu "Example Configuration"

    orsource "$IDF_PATH/examples/common_components/env_caps/$IDF_TARGET/Kconfig.env_caps"

    config APP_OLED_DEBUG_ONLY
        bool "Run OLED debug only"
        default n
        help
            Disable Wi-Fi bridge and USB NCM so the USB port can be used as a
            TinyUSB CDC serial monitor while debugging the OLED.

    config EXAMPLE_RECONFIGURE_BUTTON
        int "Button for switching to reconfigure mode"
        range ENV_GPIO_RANGE_MIN ENV_GPIO_IN_RANGE_MAX
        default 0
        help
            The button on this GPIO is used to reset the board to
            the reconfiguration mode, i.e. to restart provisioning
            or manual configuration of Wi-Fi settings (ssid, password)

    menu "OLED diagnostics"

        config DIAG_OLED_ENABLED
            bool "Enable SH1106 OLED diagnostics UI"
            default y

        config DIAG_OLED_I2C_ADDR
            hex "SH1106 I2C address"
            default 0x3C
            depends on DIAG_OLED_ENABLED

        config DIAG_OLED_SDA_GPIO
            int "OLED SDA GPIO"
            range ENV_GPIO_RANGE_MIN ENV_GPIO_IN_RANGE_MAX
            default 39
            depends on DIAG_OLED_ENABLED

        config DIAG_OLED_SCL_GPIO
            int "OLED SCL GPIO"
            range ENV_GPIO_RANGE_MIN ENV_GPIO_IN_RANGE_MAX
            default 37
            depends on DIAG_OLED_ENABLED

        config DIAG_ENCODER_A_GPIO
            int "EC11 encoder A GPIO"
            range ENV_GPIO_RANGE_MIN ENV_GPIO_IN_RANGE_MAX
            default 33
            depends on DIAG_OLED_ENABLED

        config DIAG_ENCODER_B_GPIO
            int "EC11 encoder B GPIO"
            range ENV_GPIO_RANGE_MIN ENV_GPIO_IN_RANGE_MAX
            default 18
            depends on DIAG_OLED_ENABLED

        config DIAG_BACK_GPIO
            int "BACK button GPIO"
            range ENV_GPIO_RANGE_MIN ENV_GPIO_IN_RANGE_MAX
            default 16
            depends on DIAG_OLED_ENABLED

        config DIAG_CONFIRM_GPIO
            int "CONFIRM button GPIO"
            range ENV_GPIO_RANGE_MIN ENV_GPIO_IN_RANGE_MAX
            default 35
            depends on DIAG_OLED_ENABLED

        config DIAG_OLED_UPDATE_MS
            int "OLED refresh interval in ms"
            default 1000
            range 200 10000
            depends on DIAG_OLED_ENABLED

    endmenu

endmenu
```
